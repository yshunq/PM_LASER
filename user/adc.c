#include "adc.h"

const u16 TEMP_DATA[]={
	54810, 51935, 49242, 46725, 44374, // -10 ~ -6	 1
	42180, 39939, 37899, 36023, 34284, // -5  ~ -1	 2
	32742, 31113, 29575, 28122, 26749, //  0  ~  4   3
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      908,   881,   854,   828,   804, //  90 ~ 94   21
 };


void ADC_Init(void)
{
	ADCCFG = 0x2f;                              //设置ADC时钟为系统时钟/2/16/16 转换结果右对齐
  	ADC_CONTR = 0x80;                           //使能ADC模块 打开ADC_POWER
}

unsigned char get_water_temp(void)
{
	u8 temp,i;
	u32 buff,lg1,adc_val;
	ADC_CONTR |= 0x4C;                      //启动AD转换  ADC_START = 1
	_nop_();
	_nop_();
	while (!(ADC_CONTR & 0x20));            //查询ADC完成标志
	ADC_CONTR &= ~0x20;                     //清完成标志
	buff = (ADC_RES<<8)|ADC_RESL;			//取转换结果
	adc_val = 5000*buff/1024;				//计算出电压值
	
	if(adc_val > 4700){//开路
		temp = 0xff;
		goto over_water_temp;
	}else if(adc_val < 500){//短路
		temp = 0xfe;
		goto over_water_temp;
	}	
	
	buff = (5000 - adc_val)/10;					//电流流过10K电流
	lg1 = adc_val*1000;
	lg1 = lg1/buff;											//电压除以电流等于电阻
	
	if(lg1>54810){ //小于-10度
		temp = 0;
		goto over_water_temp;
	}else if(lg1<804){ //大于94度
		temp = 104;
		goto over_water_temp;
	}
	
	for(i=0;i<104;i++){ //对比组织表
		buff=(u32)TEMP_DATA[i];
		if(lg1>=buff)
		break;
	}
	temp = i;
	
	over_water_temp:
	_nop_();
	return temp;
}



